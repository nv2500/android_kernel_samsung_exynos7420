## drivers/cpufreq/Kconfig
```kconfig
menu "CPU Frequency scaling"

config CPU_FREQ
	bool "CPU Frequency scaling"
	help
	  CPU Frequency scaling allows you to change the clock speed of 
	  CPUs on the fly. This is a nice method to save power, because 
	  the lower the CPU clock speed, the less power the CPU consumes.

	  Note that this driver doesn't automatically change the CPU
	  clock speed, you need to either enable a dynamic cpufreq governor
	  (see below) after boot, or use a userspace tool.

	  For details, take a look at <file:Documentation/cpu-freq>.

	  If in doubt, say N.

if CPU_FREQ

config CPU_FREQ_TABLE
	tristate

config CPU_FREQ_GOV_COMMON
	bool

config CPU_FREQ_STAT
	tristate "CPU frequency translation statistics"
	select CPU_FREQ_TABLE
	default y
	help
	  This driver exports CPU frequency statistics information through sysfs
	  file system.

	  To compile this driver as a module, choose M here: the
	  module will be called cpufreq_stats.

	  If in doubt, say N.

config CPU_FREQ_STAT_DETAILS
	bool "CPU frequency translation statistics details"
	depends on CPU_FREQ_STAT
	help
	  This will show detail CPU frequency translation table in sysfs file
	  system.

	  If in doubt, say N.

choice
	prompt "Default CPUFreq governor"
	default CPU_FREQ_DEFAULT_GOV_USERSPACE if ARM_SA1100_CPUFREQ || ARM_SA1110_CPUFREQ
	default CPU_FREQ_DEFAULT_GOV_PERFORMANCE
	help
	  This option sets which CPUFreq governor shall be loaded at
	  startup. If in doubt, select 'performance'.

config CPU_FREQ_DEFAULT_GOV_PERFORMANCE
	bool "performance"
	select CPU_FREQ_GOV_PERFORMANCE
	help
	  Use the CPUFreq governor 'performance' as default. This sets
	  the frequency statically to the highest frequency supported by
	  the CPU.

config CPU_FREQ_DEFAULT_GOV_POWERSAVE
	bool "powersave"
	depends on EXPERT
	select CPU_FREQ_GOV_POWERSAVE
	help
	  Use the CPUFreq governor 'powersave' as default. This sets
	  the frequency statically to the lowest frequency supported by
	  the CPU.

config CPU_FREQ_DEFAULT_GOV_CONSERVATIVEX
	bool "conservativex"
	select CPU_FREQ_GOV_CONSERVATIVEX
	help
	  Use the CPUFreq governor 'conservativex' as default.

config CPU_FREQ_DEFAULT_GOV_BLUACTIVE
	bool "bluactive"
	select CPU_FREQ_GOV_BLUACTIVE
	help
	Use the CPUFreq governor 'bluactive' as default.

	 
config CPU_FREQ_DEFAULT_GOV_PRESERVATIVE
	bool "preservative"
	select CPU_FREQ_GOV_PRESERVATIVE
	select CPU_FREQ_GOV_PERFORMANCE
	help
	 Use the CPUFreq governor 'preservative' as default.

config CPU_FREQ_DEFAULT_GOV_HYPER
	bool "hyper"
	select CPU_FREQ_GOV_HYPER
	---help---
	Use the CPUFreq governor 'hyper' as default. This allows
	you to get a full dynamic cpu frequency capable system by simply
	loading your cpufreq low-level hardware driver, using the
	'hyper' governor for latency-sensitive workloads.

config CPU_FREQ_DEFAULT_GOV_MINMAX 
        bool "minmax"
        select CPU_FREQ_GOV_MINMAX 
        select CPU_FREQ_GOV_PERFORMANCE
        help
          Use the CPUFreq governor 'minmax' as default. This minimizes the 
          frequency jumps does by the governor. This is aimed at maximizing 
          both perfomance and battery life.

config CPU_FREQ_DEFAULT_GOV_PEGASUSQ
	bool "pegasusq"
	select CPU_FREQ_GOV_PEGASUSQ
	help
	Use the CPUFreq governor 'pegasusq' as default.

config CPU_FREQ_DEFAULT_GOV_INTELLIMM
        bool "intelliminmax"
        select CPU_FREQ_GOV_INTELLIMM
        help
          Use the CPUFreq governor 'intelliminmax' as default. This is
          governor will use only 3 different frequencies, idle, UI and max

config CPU_FREQ_DEFAULT_GOV_WAVE
	bool "wave"
	select CPU_FREQ_GOV_WAVE
	help


config CPU_FREQ_DEFAULT_GOV_USERSPACE
	bool "userspace"
	select CPU_FREQ_GOV_USERSPACE
	help
	  Use the CPUFreq governor 'userspace' as default. This allows
	  you to set the CPU frequency manually or when a userspace 
	  program shall be able to set the CPU dynamically without having
	  to enable the userspace governor manually.

config CPU_FREQ_DEFAULT_GOV_ONDEMAND
	bool "ondemand"
	select CPU_FREQ_GOV_ONDEMAND
	select CPU_FREQ_GOV_PERFORMANCE
	help
	  Use the CPUFreq governor 'ondemand' as default. This allows
	  you to get a full dynamic frequency capable system by simply
	  loading your cpufreq low-level hardware driver.
	  Be aware that not all cpufreq drivers support the ondemand
	  governor. If unsure have a look at the help section of the
	  driver. Fallback governor will be the performance governor.

config CPU_FREQ_DEFAULT_GOV_CONSERVATIVE
	bool "conservative"
	select CPU_FREQ_GOV_CONSERVATIVE
	select CPU_FREQ_GOV_PERFORMANCE
	help
	  Use the CPUFreq governor 'conservative' as default. This allows
	  you to get a full dynamic frequency capable system by simply
	  loading your cpufreq low-level hardware driver.
	  Be aware that not all cpufreq drivers support the conservative
	  governor. If unsure have a look at the help section of the
	  driver. Fallback governor will be the performance governor.

config CPU_FREQ_DEFAULT_GOV_INTERACTIVES9
	bool "interactiveS9"
	select CPU_FREQ_GOV_INTERACTIVES9
	help
	  Use the CPUFreq governor 'interactiveS9' as default. This allows
	  you to get a full dynamic cpu frequency capable system by simply
	  loading your cpufreq low-level hardware driver, using the
	  'interactiveS9' governor for latency-sensitive workloads.

config CPU_FREQ_DEFAULT_GOV_THUNDERSTORMS_INTERACTIVE
	bool "thunderstorms_interactive"
	select CPU_FREQ_GOV_THUNDERSTORMS_INTERACTIVE
	help
	  Use the CPUFreq governor 'thunderstorms interactive' as default. This allows
	  you to get a full dynamic cpu frequency capable system by simply
	  loading your cpufreq low-level hardware driver, using the
	  'thunderstorms_interactive' governor for latency-sensitive workloads.

config CPU_FREQ_DEFAULT_GOV_THUNDERSTORM
	bool "thunderstorm"
	select CPU_FREQ_GOV_THUNDERSTORM
	help
	  Use the CPUFreq governor 'thunderstorm' as default. This allows
	  you to get a full dynamic cpu frequency capable system by simply
	  loading your cpufreq low-level hardware driver, using the
	  'thunderstorm' governor for latency-sensitive workloads.

config CPU_FREQ_DEFAULT_GOV_THUNDERSTORM2
	bool "thunderstorm2"
	select CPU_FREQ_GOV_THUNDERSTORM2
	help
	  Use the CPUFreq governor 'thunderstorm2' as default. This allows
	  you to get a full dynamic cpu frequency capable system by simply
	  loading your cpufreq low-level hardware driver, using the
	  'thunderstorm2' governor for latency-sensitive workloads
	  based on interactive from Samsung Galaxy S9.

config CPU_FREQ_DEFAULT_GOV_INTERACTIVE
	bool "interactive"
	select CPU_FREQ_GOV_INTERACTIVE
	help
	  Use the CPUFreq governor 'interactive' as default. This allows
	  you to get a full dynamic cpu frequency capable system by simply
	  loading your cpufreq low-level hardware driver, using the
	  'interactive' governor for latency-sensitive workloads.

config CPU_FREQ_DEFAULT_GOV_NEXUS
	bool "nexus"
	select CPU_FREQ_GOV_NEXUS
	help
	  Use the CPUFreq governor 'nexus' as default.

config CPU_FREQ_DEFAULT_GOV_DANCEDANCE
            bool "dancedance"
            select CPU_FREQ_GOV_DANCEDANCE
            help
              Use the CPUFreq governor 'dancedance' as default.

config CPU_FREQ_DEFAULT_GOV_LIONHEART
            bool "lionheart"
            select CPU_FREQ_GOV_LIONHEART
            help
              Use the CPUFreq governor 'lionheart' as default.

config CPU_FREQ_DEFAULT_GOV_WHEATLEY
	bool "wheatley"
	select CPU_FREQ_GOV_WHEATLEY
	select CPU_FREQ_GOV_PERFORMANCE
	help
	  Use the CPUFreq governor 'wheatley' as default.

config CPU_FREQ_DEFAULT_GOV_INTELLIACTIVE
	bool "intelliactive"
	select CPU_FREQ_GOV_PEGASUSQ
	help
	Use the CPUFreq governor 'intelliactive' as default.

config CPU_FREQ_DEFAULT_GOV_ONDEMANDPLUS
	bool "ondemandplus"
	select CPU_FREQ_GOV_ONDEMANDPLUS
	---help---
  	     Use the CPUFreq governor 'ondemandplus' as default. This allows
	     you to get a full dynamic frequency capable system by simply
	     loading your cpufreq low-level hardware driver.
	     Be aware that not all cpufreq drivers support the ondemandplus
	     governor. If unsure have a look at the help section of the
	     driver. Fallback governor will be the performance governor.


config CPU_FREQ_DEFAULT_GOV_SMARTASS2
  	bool "smartassV2"
  	select CPU_FREQ_GOV_SMARTASS2
  	help

config CPU_FREQ_DEFAULT_GOV_NIGHTMARE
	bool "nightmare"
	select CPU_FREQ_GOV_NIGHTMARE
	help

config CPU_FREQ_DEFAULT_GOV_DARKNESS
	bool "darkness"
  	select CPU_FREQ_GOV_DARKNESS
  	help

config CPU_FREQ_DEFAULT_GOV_ALUCARD
  	bool "alucard"
  	select CPU_FREQ_GOV_ALUCARD
  	help

config CPU_FREQ_DEFAULT_GOV_LAZY
	bool "lazy"
	select CPU_FREQ_GOV_LAZY
	select CPU_FREQ_GOV_PERFORMANCE
	help
	  Use the CPUFreq governor 'lazy' as default.

config CPU_FREQ_DEFAULT_GOV_LAGFREE
        bool "lagfree"
        select CPU_FREQ_GOV_LAGFREE
        select CPU_FREQ_GOV_PERFORMANCE
        help
          Use the CPUFreq governor 'lagfree' as default. This allows
          you to get a full dynamic frequency capable system by simply
          loading your cpufreq low-level hardware driver.
          Be aware that not all cpufreq drivers support the lagfree
          governor. If unsure have a look at the help section of the
          driver. Fallback governor will be the performance governor.

config CPU_FREQ_DEFAULT_GOV_INTELLIDEMAND
	bool "intellidemand"
	select CPU_FREQ_GOV_INTELLIDEMAND
	select CPU_FREQ_GOV_PERFORMANCE
	help
	  Use the CPUFreq governor 'intellidemand' as default.

config CPU_FREQ_DEFAULT_GOV_SAVAGEDZEN
	bool "savagedzen"
	select CPU_FREQ_GOV_SAVAGEDZEN
	select CPU_FREQ_GOV_PERFORMANCE
	help
	  Use the CPUFreq governor 'savagedzen' as default.

config CPU_FREQ_DEFAULT_GOV_SCARY
	bool "scary"
	select CPU_FREQ_GOV_SCARY
	select CPU_FREQ_GOV_SCARY
	help
	  Use the CPUFreq governor 'scary' as default.

config CPU_FREQ_DEFAULT_GOV_BADASS
	bool "badass"
	select CPU_FREQ_GOV_BADASS
	select CPU_FREQ_GOV_PERFORMANCE
	help
	  Use the CPUFreq governor 'badass' as default. This allows
	  you to get a full dynamic frequency capable system by simply
	  loading your cpufreq low-level hardware driver.
	  Be aware that not all cpufreq drivers support the badass
	  governor. If unsure have a look at the help section of the
	  driver. Fallback governor will be the performance governor.

config CPU_FREQ_DEFAULT_GOV_SAKURACTIVE
        bool "sakuractive"
        select CPU_FREQ_GOV_SAKURACTIVE
        select CPU_FREQ_GOV_PERFORMANCE
        help
          Use the CPUFreq governor 'sakuractive' as default. This allows you
          to get a full dynamic frequency capable system with CPU
          hotplug support by simply loading your cpufreq low-level
          hardware driver.  Be aware that not all cpufreq drivers
          support the hotplug governor. If unsure have a look at
          the help section of the driver. Fallback governor will be the
          performance governor.

config CPU_FREQ_DEFAULT_GOV_INTERACTIVEX
        bool "interactiveX"
        select CPU_FREQ_GOV_INTERACTIVEX
        help
          Use the CPUFreq governor 'interactiveX' as default.

config CPU_FREQ_DEFAULT_GOV_DYNAMIC_INTERACTIVE
        bool "dynamic interactive"
        select CPU_FREQ_GOV_DYNAMIC_INTERACTIVE
        help
          Use the CPUFreq governor 'dynamic interactive' as default. This allows
          you to get a full dynamic cpu frequency capable system by simply
          loading your cpufreq low-level hardware driver, using the
          'interactive' governor for latency-sensitive workloads. This governor
          changes its tunables by itself depending on the load of the system.

config CPU_FREQ_DEFAULT_GOV_ONDEMANDX
        bool "ondemandx"
        select CPU_FREQ_GOV_ONDEMANDX
        select CPU_FREQ_GOV_PERFORMANCE
        help
          Use the CPUFreq governor 'lionheart' as default.

config CPU_FREQ_DEFAULT_GOV_HOTPLUG
        bool "hotplug"
        select CPU_FREQ_GOV_HOTPLUG
        select CPU_FREQ_GOV_PERFORMANCE
        help
          Use the CPUFreq governor 'hotplug' as default. This allows you
          to get a full dynamic frequency capable system with CPU
          hotplug support by simply loading your cpufreq low-level
          hardware driver. Be aware that not all cpufreq drivers
          support the hotplug governor. If unsure have a look at
          the help section of the driver. Fallback governor will be the
          performance governor.

config CPU_FREQ_DEFAULT_GOV_ADAPTIVE 
        bool "adaptive"
        select CPU_FREQ_GOV_ADAPTIVE
        help
          Use the CPUFreq governor 'adaptive' as default. This allows 
          you to get a full dynamic cpu frequency capable system by simply 
          loading your cpufreq low-level hardware driver, using the
          'adaptive' governor for latency-sensitive workloads and demanding 
          performance. 

config CPU_FREQ_DEFAULT_GOV_LULZACTIVE
        bool "lulzactive" 
        select CPU_FREQ_GOV_LULZACTIVE 
        select CPU_FREQ_GOV_PERFORMANCE 
        help
          Use the CPUFreq governor 'lulzactive' as default.

config CPU_FREQ_DEFAULT_GOV_LULZACTIVEQ 
        bool "lulzactiveq" 
        select CPU_FREQ_GOV_LULZACTIVEQ
        select CPU_FREQ_GOV_PERFORMANCE 
        help 
          Use the CPUFreq governor 'lulzactiveq' as default.

config CPU_FREQ_DEFAULT_GOV_ADAPTIVEX
	bool "adaptivex"
	select CPU_FREQ_GOV_ADAPTIVEX
	help
	  Use the CPUFreq governor 'adaptiveX' as default.
	  'adaptive' with suspend/wake and CPU hotplugging support.

config CPU_FREQ_DEFAULT_GOV_ZENX
	bool "ZenX"
	select CPU_FREQ_GOV_ZENX
	help
	  Use the CPUFreq governor 'ZenX' as default.

config CPU_FREQ_DEFAULT_GOV_THUNDERSTORMS
	bool "thunderstorms"
	select CPU_FREQ_GOV_THUNDERSTORMS
	help
	  Use the CPUFreq governor 'thunderstorms' as default. This allows
	  you to get a full dynamic cpu frequency capable system by simply
	  loading your cpufreq low-level hardware driver, using the
	  'thunderstorms' governor for latency-sensitive workloads.

endchoice

config CPU_FREQ_GOV_PERFORMANCE
	tristate "'performance' governor"
	help
	  This cpufreq governor sets the frequency statically to the
	  highest available CPU frequency.

	  To compile this driver as a module, choose M here: the
	  module will be called cpufreq_performance.

	  If in doubt, say Y.

config CPU_FREQ_GOV_POWERSAVE
	tristate "'powersave' governor"
	help
	  This cpufreq governor sets the frequency statically to the
	  lowest available CPU frequency.

	  To compile this driver as a module, choose M here: the
	  module will be called cpufreq_powersave.

	  If in doubt, say Y.

config CPU_FREQ_GOV_USERSPACE
	tristate "'userspace' governor for userspace frequency scaling"
	help
	  Enable this cpufreq governor when you either want to set the
	  CPU frequency manually or when a userspace program shall
	  be able to set the CPU dynamically, like on LART 
	  <http://www.lartmaker.nl/>.

	  To compile this driver as a module, choose M here: the
	  module will be called cpufreq_userspace.

	  For details, take a look at <file:Documentation/cpu-freq/>.

	  If in doubt, say Y.

config CPU_FREQ_GOV_ONDEMAND
	tristate "'ondemand' cpufreq policy governor"
	select CPU_FREQ_TABLE
	select CPU_FREQ_GOV_COMMON
	help
	  'ondemand' - This driver adds a dynamic cpufreq policy governor.
	  The governor does a periodic polling and 
	  changes frequency based on the CPU utilization.
	  The support for this governor depends on CPU capability to
	  do fast frequency switching (i.e, very low latency frequency
	  transitions). 

	  To compile this driver as a module, choose M here: the
	  module will be called cpufreq_ondemand.

	  For details, take a look at linux/Documentation/cpu-freq.

	  If in doubt, say N.

config CPU_FREQ_GOV_NEXUS
	tristate "'nexus' cpufreq policy governor"
	help
	  Compile the CPUFreq governor 'nexus'.

	  To compile this driver as a module, choose M here: the
	  module will be called cpufreq_interactive.

	  For details, take a look at linux/Documentation/cpu-freq.

	  If in doubt, say N.

config CPU_FREQ_GOV_ONDEMAND_2_PHASE
	tristate "'2-phase' power-efficiency ondemand algorithm"
	depends on CPU_FREQ_GOV_ONDEMAND
	help
	  '2-phase' - This driver adds a new algo to save power

config CPU_FREQ_GOV_INTERACTIVES9
	tristate "'interactive' cpufreq policy governor"
	help
	  'interactiveS9' - This driver adds a dynamic cpufreq policy governor
	  designed for latency-sensitive workloads.

	  This governor attempts to reduce the latency of clock
	  increases so that the system is more responsive to
	  interactiveS9 workloads.

	  To compile this driver as a module, choose M here: the
	  module will be called cpufreq_interactivev2.

	  For details, take a look at linux/Documentation/cpu-freq.

	  If in doubt, say N.

config CPU_FREQ_GOV_THUNDERSTORM
	tristate "'thunderstorm' cpufreq policy governor"
	depends on CPU_FREQ

config CPU_FREQ_GOV_THUNDERSTORM2
	tristate "'thunderstorm2' cpufreq policy governor"
	depends on CPU_FREQ

config CPU_FREQ_GOV_THUNDERSTORMS_INTERACTIVE
	tristate "'thunderstorms_interactive' cpufreq policy governor"
	depends on CPU_FREQ

config CPU_FREQ_GOV_INTERACTIVE
	tristate "'interactive' cpufreq policy governor"
	help
	  'interactive' - This driver adds a dynamic cpufreq policy governor
	  designed for latency-sensitive workloads.

	  This governor attempts to reduce the latency of clock
	  increases so that the system is more responsive to
	  interactive workloads.

	  To compile this driver as a module, choose M here: the
	  module will be called cpufreq_interactive.

	  For details, take a look at linux/Documentation/cpu-freq.

	  If in doubt, say N.

config MODE_AUTO_CHANGE
	bool "automatic governor parameter change"
	depends on CPU_FREQ_GOV_INTERACTIVE
	default n
	help
		automatic governor parameter change by MODE

config CPU_FREQ_GOV_CONSERVATIVE
	tristate "'conservative' cpufreq governor"
	depends on CPU_FREQ
	select CPU_FREQ_GOV_COMMON
	help
	  'conservative' - this driver is rather similar to the 'ondemand'
	  governor both in its source code and its purpose, the difference is
	  its optimisation for better suitability in a battery powered
	  environment.  The frequency is gracefully increased and decreased
	  rather than jumping to 100% when speed is required.

	  If you have a desktop machine then you should really be considering
	  the 'ondemand' governor instead, however if you are using a laptop,
	  PDA or even an AMD64 based computer (due to the unacceptable
	  step-by-step latency issues between the minimum and maximum frequency
	  transitions in the CPU) you will probably want to use this governor.

	  To compile this driver as a module, choose M here: the
	  module will be called cpufreq_conservative.

	  For details, take a look at linux/Documentation/cpu-freq.

	  If in doubt, say N.

config CPU_FREQ_DEFAULT_GOV_BIOSHOCK
	bool "BioShock"
	select CPU_FREQ_GOV_BIOSHOCK
	help
	  Default governor of BioShock kernel

config CPU_FREQ_GOV_DANCEDANCE
           tristate "'dancedance' cpufreq governor"
           depends on CPU_FREQ
           help
             dancedance' - a "smart" optimized governor!
             If in doubt, say N.

config CPU_FREQ_GOV_LIONHEART
           tristate "'lionheart' cpufreq governor"
           depends on CPU_FREQ
           help
             lionheart' - a "smart" optimized governor!
             If in doubt, say N.

config CPU_FREQ_GOV_CONSERVATIVEX
	tristate "'conservativex' cpufreq governor"
	depends on CPU_FREQ
	help
	  'conservativex' - less aggressive version of conservative

config CPU_FREQ_GOV_BLUACTIVE
	tristate "'bluactive' cpufreq governor"
	depends on CPU_FREQ
	help
	  'bluactive' - less aggressive version of conservative

config CPU_FREQ_GOV_PRESERVATIVE
	tristate "'preservative' cpufreq governor"
	depends on CPU_FREQ

config CPU_FREQ_GOV_PEGASUSQ
	tristate "'pegasusq' cpufreq policy governor"

config CPU_FREQ_GOV_INTELLIMM
        tristate "'intelliminmax' cpufreq policy governor"
        help
          To compile this driver as a module, choose M here: the
          module will be called cpufreq_interactive.

          For details, take a look at linux/Documentation/cpu-freq.

          If in doubt, say N.

config CPU_FREQ_GOV_WAVE
	tristate "'wave' cpufreq governor"
	depends on CPU_FREQ

config CPU_FREQ_GOV_WHEATLEY
	   tristate "'wheatley' cpufreq governor"
	   depends on CPU_FREQ

config CPU_FREQ_GOV_ONDEMANDPLUS
	tristate "'ondemandplus' cpufreq policy governor"
	depends on CPU_FREQ
	---help---
	 'ondemandplus' - This driver adds a dynamic cpufreq policy
	 governor. The governor does a periodic polling and
	 changes frequency based on the CPU utilization.
	 The support for this governor depends on CPU capability to
	 do fast frequency switching (i.e, very low latency frequency
	 transitions).

	 To compile this driver as a module, choose M here: the
	 module will be called cpufreq_ondemandplus.

	 For details, take a look at linux/Documentation/cpu-freq.

	 If in doubt, say N.

config CPU_FREQ_GOV_SMARTASS2
  	tristate "'smartassV2' cpufreq governor"
  	depends on CPU_FREQ
  	help
    	'smartassV2' - a "smart" governor


config CPU_FREQ_GOV_NIGHTMARE
	tristate "'nightmare' cpufreq governor"
	depends on CPU_FREQ

config CPU_FREQ_GOV_DARKNESS
	tristate "'darkness' cpufreq governor"
	depends on CPU_FREQ

config CPU_FREQ_GOV_BIOSHOCK
	tristate "'bioshock' cpufreq bioshock"
	depends on CPU_FREQ
	help
	  'bioshock' - More aggressive version of conservative

config CPU_FREQ_GOV_ALUCARD
	tristate "'alucard' cpufreq governor"
	depends on CPU_FREQ

config CPU_FREQ_GOV_HYPER
	tristate "'hyper' cpufreq governor"
	depends on CPU_FREQ
	---help---
	'hyper' - A tweaked "ondemand" based smart and smooth optimized governor!
	If in doubt, say N.

config GENERIC_CPUFREQ_CPU0
	tristate "Generic CPU0 cpufreq driver"
	depends on HAVE_CLK && REGULATOR && PM_OPP && OF
	select CPU_FREQ_TABLE
	help
	  This adds a generic cpufreq driver for CPU0 frequency management.
	  It supports both uniprocessor (UP) and symmetric multiprocessor (SMP)
	  systems which share clock and voltage across all CPUs.

	  If in doubt, say N.

config EXYNOS7420_CPU_UNDERCLOCK
	bool "Exynos7420 min cpu frequenz"
	depends on ARM_EXYNOS7420_CPUFREQ
	help
	   Sets Apollo and Atlas clusters to min cpu frequenz
	   
config EXYNOS7420_CPU_OVERCLOCK
	bool "Exynos7420 max cpu frequenz"
	depends on ARM_EXYNOS7420_CPUFREQ
	help
	   Sets Apollo and Atlas clusters to max cpu frequenz

config CPU_FREQ_GOV_LAZY
	tristate "'lazy' cpufreq governor"
	depends on CPU_FREQ

config CPU_FREQ_GOV_LAGFREE
        tristate "'lagfree' cpufreq governor"
        depends on CPU_FREQ
        help
          'lagfree' - this driver is rather similar to the 'ondemand'
          governor both in its source code and its purpose, the difference is
          its optimisation for better suitability in a battery powered
          environment.  The frequency is gracefully increased and decreased
          rather than jumping to 100% when speed is required.

config LAGFREE_MAX_LOAD
	int "Max CPU Load"
	default 50
	depends on CPU_FREQ_GOV_LAGFREE
	help
	  CPU freq will be increased if measured load > max_cpu_load;

config LAGFREE_MIN_LOAD
	int "Min CPU Load"
	default 15
	depends on CPU_FREQ_GOV_LAGFREE
	help
	  CPU freq will be decrease if measured load < min_cpu_load;

config LAGFREE_FREQ_STEP_DOWN
	int "Frequency Step Down"
	default 108000
	depends on CPU_FREQ_GOV_LAGFREE
	help
	  Max freqeuncy delta when ramping down.

config LAGFREE_FREQ_SLEEP_MAX
	int "Max Sleep frequeny"
	default 384000
	depends on CPU_FREQ_GOV_LAGFREE
	help
	  Max freqeuncy for screen off.

config LAGFREE_FREQ_AWAKE_MIN
	int "Min Awake frequeny"
	default 384000
	depends on CPU_FREQ_GOV_LAGFREE
	help
	  Min freqeuncy for screen on.

config LAGFREE_FREQ_STEP_UP_SLEEP_PERCENT
	int "Freq step up percent sleep"
	default 20
	depends on CPU_FREQ_GOV_LAGFREE
	help
	  Frequency percent to step up while screen off.

config CPU_FREQ_MIN_TICKS
	int "Ticks between governor polling interval."
	default 10
	help
	  Minimum number of ticks between polling interval for governors.

config CPU_FREQ_SAMPLING_LATENCY_MULTIPLIER
	int "Sampling rate multiplier for governors."
	default 1000
	help
	  Sampling latency rate multiplied by the cpu switch latency.
	  Affects governor polling.

config CPU_FREQ_GOV_INTELLIDEMAND
	tristate "'intellidemand' cpufreq governor"
	depends on CPU_FREQ

config CPU_FREQ_GOV_SAVAGEDZEN
	tristate "'savagedzen' cpufreq governor"
	depends on CPU_FREQ

config CPU_FREQ_GOV_SCARY
	tristate "'scary' cpufreq governor"
	depends on CPU_FREQ
	help
	  scary - a governor for cabbages
	  If in doubt, say N.

config CPU_FREQ_GOV_BADASS
	tristate "'badass' cpufreq policy governor"
	select CPU_FREQ_TABLE
	help
	  'badass' - This driver adds a dynamic cpufreq policy governor.
	  The governor does a periodic polling and
	  changes frequency based on the CPU utilization.
	  The support for this governor depends on CPU capability to
	  do fast frequency switching (i.e, very low latency frequency
	  transitions).

	  To compile this driver as a module, choose M here: the
	  module will be called cpufreq_badass.

	  If in doubt, say N.

config CPU_FREQ_GOV_BADASS_2_PHASE
	tristate "'2-phase' power-efficiency badass algorithm"
	depends on CPU_FREQ_GOV_BADASS
	help
	  '2-phase' - This driver adds a new algo to save power

config CPU_FREQ_GOV_BADASS_2_PHASE_FREQ
	int "'2-phase' badass frequency"
	default 918000
	depends on CPU_FREQ_GOV_BADASS
	depends on CPU_FREQ_GOV_BADASS_2_PHASE

config CPU_FREQ_GOV_BADASS_3_PHASE
	tristate "'3-phase' power-efficiency badass algorithm"
	depends on CPU_FREQ_GOV_BADASS
	depends on CPU_FREQ_GOV_BADASS_2_PHASE
	help
	  '3-phase' - This driver adds a new algo to save power

config CPU_FREQ_GOV_BADASS_3_PHASE_FREQ
	int "'3-phase' badass frequency"
	default 1188000
	depends on CPU_FREQ_GOV_BADASS
	depends on CPU_FREQ_GOV_BADASS_2_PHASE
	depends on CPU_FREQ_GOV_BADASS_3_PHASE

config CPU_FREQ_GOV_BADASS_GPU_CONTROL
	tristate "'gpu_control' power-efficiency badass algorithm"
	depends on CPU_FREQ_GOV_BADASS
	depends on CPU_FREQ_GOV_BADASS_2_PHASE
	help
	  'gpu_control' - This driver adds a new algo to save power

config CPU_FREQ_GOV_BADASS_LOWBAT_POWERSAVE
	tristate "'lowbat_powersave' power-efficiency badass algorithm"
	depends on CPU_FREQ_GOV_BADASS
	help
	  'lowbat_powersave' - This driver adds a new algo to save power

config CPU_FREQ_GOV_BADASS_ALLOW_BYPASS
	tristate "Allows bypassing phases"
	depends on CPU_FREQ_GOV_BADASS
	depends on CPU_FREQ_GOV_BADASS_2_PHASE
	help
	  'allow_bypass' - This driver adds a bypass to the phases

config CPU_FREQ_GOV_SAKURACTIVE
        tristate "'sakuractive' cpufreq governor"
        depends on CPU_FREQ && NO_HZ && HOTPLUG_CPU
        help
        'sakuractive' - this driver mimics the frequency scaling behavior
        in 'ondemand', but with several key differences.  First is
        that frequency transitions use the CPUFreq table directly,
        instead of incrementing in a percentage of the maximum
        available frequency.  Second 'sakuractive' will offline auxillary
        CPUs when the system is idle, and online those CPUs once the
        system becomes busy again.  This last feature is needed for
        architectures which transition to low power states when only
        the "master" CPU is online, or for thermally constrained
        devices.

        If you don't have one of these architectures or devices, use
        'ondemand' instead.

        If in doubt, say N.

config CPU_FREQ_GOV_INTERACTIVEX
        tristate "'interactiveX' cpufreq governor"
        depends on CPU_FREQ
        help
          'interactiveX' - interactive governor with early suspend support added.
          This governor uses hotplug to shutdown and start up cpu1 when suspended.
          If in doubt, say N.

config CPU_FREQ_GOV_DYNAMIC_INTERACTIVE
        tristate "'dynamic interactive' cpufreq policy governor"
        help
          'dynamic interactive' - This driver adds a dynamic cpufreq policy governor
          designed for latency-sensitive workloads.

          This governor attempts to reduce the latency of clock
          increases so that the system is more responsive to
          interactive workloads.

          To compile this driver as a module, choose M here: the
          module will be called cpufreq_interactive.

          For details, take a look at linux/Documentation/cpu-freq.

          If in doubt, say N.

config CPU_FREQ_GOV_HOTPLUG
        tristate "'hotplug' cpufreq governor"
        depends on CPU_FREQ && NO_HZ && HOTPLUG_CPU
        help
          'hotplug' - this driver mimics the frequency scaling behavior
          in 'ondemand', but with several key differences. First is
          that frequency transitions use the CPUFreq table directly,
          instead of incrementing in a percentage of the maximum
          available frequency. Second 'hotplug' will offline auxillary
          CPUs when the system is idle, and online those CPUs once the
          system becomes busy again. This last feature is needed for
          architectures which transition to low power states when only
          the "master" CPU is online, or for thermally constrained
          devices.

          If you don't have one of these architectures or devices, use
          'ondemand' instead.

          If in doubt, say N.

config CPU_FREQ_GOV_ONDEMANDX
        tristate "'ondemandx' cpufreq governor"
        depends on CPU_FREQ

config CPU_FREQ_GOV_ADAPTIVE 
        tristate "'adaptive' cpufreq policy governor" 
        help
          'adaptive' - This driver adds a dynamic cpufreq policy governor 
          designed for latency-sensitive workloads and also for demanding
          performance. 

          This governor attempts to reduce the latency of clock
          increases so that the system is more responsive to
          interactive workloads in loweset steady-state but to
          to reduce power consumption in middle operation level level up
          will be done in step by step to prohibit system from going to 
          max operation level. 

          To compile this driver as a module, choose M here: the 
          module will be called cpufreq_adaptive.

          For details, take a look at linux/Documentation/cpu-freq. 

          If in doubt, say N.

config CPU_FREQ_GOV_LULZACTIVE 
        tristate "'lulzactive' cpufreq governor"
        depends on CPU_FREQ 
        help
          'lulzactive' - a new interactive governor by Tegrak! 
          If in doubt, say N. 

config CPU_FREQ_GOV_LULZACTIVEQ 
        tristate "'lulzactiveq' cpufreq governor" 
        depends on CPU_FREQ
        help 
          'lulzactiveq' - a new interactive governor by Tegrak! 
          If in doubt, say N.

config CPU_FREQ_GOV_MINMAX 
        tristate "'minmax' cpufreq governor" 
        depends on CPU_FREQ 
        help
          'minmax' - this driver tries to minimize the frequency jumps by limiting 
          the the selected frequencies to either the min or the max frequency of 
          the policy. The frequency is selected according to the load. 
          If in doubt, say N. 

config CPU_FREQ_GOV_ADAPTIVEX
	tristate "'adaptiveX' cpufreq policy governor"
	help
	  'adaptive' with suspend/wake/hotplugging support.

config CPU_FREQ_GOV_ZENX
	tristate "'ZenX' cpufreq governor"
	depends on CPU_FREQ
	help
	  'ZenX' - an interactive-based governor

	  This governor provides full CPU hotplugging support
	  based on average CPU load across all CPUs.

	  For details, take a look at linux/Documentation/cpu-freq.

	  If in doubt, say N

config CPU_BOOST
	tristate "Event base short term CPU freq boost"
	depends on CPU_FREQ
	help
	  This driver boosts the frequency of one or more CPUs based on
	  various events that might occur in the system. As of now, the
	  events it reacts to are:
	  - Migration of important threads from one CPU to another.

	  If in doubt, say N.

menu "x86 CPU frequency scaling drivers"
depends on X86
source "drivers/cpufreq/Kconfig.x86"
endmenu

menu "ARM CPU frequency scaling drivers"
depends on ARM || ARM64
source "drivers/cpufreq/Kconfig.arm"
endmenu

menu "AVR32 CPU frequency scaling drivers"
depends on AVR32

config AVR32_AT32AP_CPUFREQ
	bool "CPU frequency driver for AT32AP"
	depends on PLATFORM_AT32AP
	default n
	help
	  This enables the CPU frequency driver for AT32AP processors.
	  If in doubt, say N.

endmenu

menu "CPUFreq processor drivers"
depends on IA64

config IA64_ACPI_CPUFREQ
	tristate "ACPI Processor P-States driver"
	select CPU_FREQ_TABLE
	depends on ACPI_PROCESSOR
	help
	This driver adds a CPUFreq driver which utilizes the ACPI
	Processor Performance States.

	For details, take a look at <file:Documentation/cpu-freq/>.

	If in doubt, say N.

endmenu

menu "MIPS CPUFreq processor drivers"
depends on MIPS

config LOONGSON2_CPUFREQ
	tristate "Loongson2 CPUFreq Driver"
	select CPU_FREQ_TABLE
	help
	  This option adds a CPUFreq driver for loongson processors which
	  support software configurable cpu frequency.

	  Loongson2F and it's successors support this feature.

	  For details, take a look at <file:Documentation/cpu-freq/>.

	  If in doubt, say N.

endmenu

menu "PowerPC CPU frequency scaling drivers"
depends on PPC32 || PPC64
source "drivers/cpufreq/Kconfig.powerpc"
endmenu

menu "SPARC CPU frequency scaling drivers"
depends on SPARC64
config SPARC_US3_CPUFREQ
	tristate "UltraSPARC-III CPU Frequency driver"
	select CPU_FREQ_TABLE
	help
	  This adds the CPUFreq driver for UltraSPARC-III processors.

	  For details, take a look at <file:Documentation/cpu-freq>.

	  If in doubt, say N.

config SPARC_US2E_CPUFREQ
	tristate "UltraSPARC-IIe CPU Frequency driver"
	select CPU_FREQ_TABLE
	help
	  This adds the CPUFreq driver for UltraSPARC-IIe processors.

	  For details, take a look at <file:Documentation/cpu-freq>.

	  If in doubt, say N.
endmenu

menu "SH CPU Frequency scaling"
depends on SUPERH
config SH_CPU_FREQ
	tristate "SuperH CPU Frequency driver"
	select CPU_FREQ_TABLE
	help
	  This adds the cpufreq driver for SuperH. Any CPU that supports
	  clock rate rounding through the clock framework can use this
	  driver. While it will make the kernel slightly larger, this is
	  harmless for CPUs that don't support rate rounding. The driver
	  will also generate a notice in the boot log before disabling
	  itself if the CPU in question is not capable of rate rounding.

	  For details, take a look at <file:Documentation/cpu-freq>.

	  If unsure, say N.
endmenu

endif
endmenu
```
